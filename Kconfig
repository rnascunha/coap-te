## Kconfig
```kconfig
menu "CoAP-te Configuration"
	config COAP_TE_MESSAGE_ERROR
		bool "Enable error messages"
		default y
		help
			CoAP::Error type will hold string error. Set no to save some bytes.
			
	config COAP_TE_USE_COLOR
		bool "Colored log"
		default y
		help
			This option will enable colored output to terminal that support ANSI Escape sequence.
			
	choice COAP_TE_LOG_LEVEL_CHOICE
        bool "Output log level"
        default COAP_TE_LOG_DEBUG
        help
            Defines CoAP-te log level. All level above that will be showed. Select
            'none' to disable log.
            
        config COAP_TE_LOG_NONE
            bool "None"
		config COAP_TE_LOG_ERROR
            bool "Error"
		config COAP_TE_LOG_WARNING
            bool "Warning"
		config COAP_TE_LOG_DEPRECATED
            bool "Deprecated"
        config COAP_TE_LOG_STATUS
            bool "Status"
        config COAP_TE_LOG_DEBUG
            bool "Debug"
            
	endchoice #	COAP_TE_LOG_LEVEL_CHOICE
	
	config COAP_TE_LOG_LEVEL
        int
        default 0 if COAP_TE_LOG_NONE
        default 1 if COAP_TE_LOG_ERROR
        default 2 if COAP_TE_LOG_WARNING
        default 3 if COAP_TE_LOG_DEPRECATED
        default 4 if COAP_TE_LOG_STATUS
        default 5 if COAP_TE_LOG_DEBUG
	
endmenu # "CoAP-te Configuration"
```

## old/examples/esp32/engine_server/main/Kconfig.projbuild
```kconfig
menu "Example WiFi/Server Configuration"
	config ROUTER_SSID
        string "Router SSID"
        default "ROUTER_SSID"
        help
            Router SSID.

    config ROUTER_PASSWD
        string "Router password"
        default "ROUTER_PASSWD"
        help
            Router password.

    choice
        bool "AP Authentication Mode"
        default WIFI_AUTH_WPA2_PSK
        help
            Authentication mode.

        config WIFI_AUTH_OPEN
            bool "WIFI_AUTH_OPEN"
        config WIFI_AUTH_WPA_PSK
            bool "WIFI_AUTH_WPA_PSK"
        config WIFI_AUTH_WPA2_PSK
            bool "WIFI_AUTH_WPA2_PSK"
        config WIFI_AUTH_WPA_WPA2_PSK
            bool "WIFI_AUTH_WPA_WPA2_PSK"
    endchoice

    config AP_AUTHMODE
        int
        default 0 if WIFI_AUTH_OPEN
        default 2 if WIFI_AUTH_WPA_PSK
        default 3 if WIFI_AUTH_WPA2_PSK
        default 4 if WIFI_AUTH_WPA_WPA2_PSK
        help
            AP authentication mode.
            
    choice
        bool "Endpoint type"
        default IPv4
        help
            Choose endpoint type.

        config ENDPOINT_IPv4
            bool "IPv4"
        config ENDPOINT_IPv6
            bool "IPv6"
    endchoice

    config ENDPOINT_TYPE
        int
        default 0 if ENDPOINT_IPv4
        default 1 if ENDPOINT_IPv6
        help
            Choose endpoint type.
            
    config SERVER_PORT
    	int "TCP Server Port"
    	range 1 65535
    	default 5683
    	help
            Server port that the device will connect.
            
	config BUFFER_TRANSACTION
    	int "Packet size"
    	range 64 8048
    	default 512
    	help
    		Max packet size supported by a CoAP transaction
    		
    config TRANSACTION_NUM
    	int "Number of transactions"
    	range 1 50
    	default 4
    	help
    		Number of simultaneous transactions that CoAP engine can hold
endmenu
```
